## src/mainboard/framework/azalea/Kconfig
```kconfig
# SPDX-License-Identifier: GPL-2.0-only

config BOARD_FRAMEWORK_AZALEA
	select AMD_SOC_CONSOLE_UART
	select AZALIA_HDA_CODEC_SUPPORT
	select BOARD_ROMSIZE_KB_32768
	select EC_GOOGLE_CHROMEEC
	select EC_GOOGLE_CHROMEEC_ESPI
	select PCIEXP_ASPM
	select PCIEXP_CLK_PM
	select PCIEXP_COMMON_CLOCK
	select PCIEXP_L1_SUB_STATE
	select SOC_AMD_COMMON_BLOCK_USE_ESPI
	select SPI_FLASH_EXIT_4_BYTE_ADDR_MODE
	select SYSTEM_TYPE_LAPTOP
	select SOC_AMD_PHOENIX_FSP
if BOARD_FRAMEWORK_AZALEA

config MAINBOARD_DIR
	default "framework/azalea"

config MAINBOARD_PART_NUMBER
	default "Azalea"

config FMDFILE
	default "src/mainboard/\$(CONFIG_MAINBOARD_DIR)/coreboot.fmd"

if !EM100	# EM100 defaults in soc/amd/common/blocks/spi/Kconfig
config EFS_SPI_READ_MODE
	default 3	# Quad IO (1-1-4)

config EFS_SPI_SPEED
	default 0	# 66MHz

config EFS_SPI_MICRON_FLAG
	default 0

config NORMAL_READ_SPI_SPEED
	default 1	# 33MHz

config ALT_SPI_SPEED
	default 1	# 33MHz

config TPM_SPI_SPEED
	default 1	# 33MHz

endif # !EM100

endif
```

## src/mainboard/framework/dogwood/Kconfig
```kconfig
# SPDX-License-Identifier: GPL-2.0-only

config BOARD_FRAMEWORK_DOGWOOD
	select BOARD_ROMSIZE_KB_32768
	select SOC_AMD_STRIX_HALO

if BOARD_FRAMEWORK_DOGWOOD

config MAINBOARD_DIR
	default "framework/dogwood"

config MAINBOARD_PART_NUMBER
	default "Dogwood"

config FMDFILE
	default "src/mainboard/\$(CONFIG_MAINBOARD_DIR)/coreboot.fmd"

endif
```

## src/mainboard/framework/dogwood/Kconfig.name
```kconfig
# SPDX-License-Identifier: GPL-2.0-only

config BOARD_FRAMEWORK_DOGWOOD
	bool "Dogwood (Framework Desktop AMD AI 300)"
```

## src/mainboard/framework/marigold/Kconfig
```kconfig
## SPDX-License-Identifier: GPL-2.0-or-later

config BOARD_FRAMEWORK_MARIGOLD_COMMON
	def_bool n
	select BOARD_ROMSIZE_KB_32768
	select CRB_TPM
	select DRIVERS_I2C_HID
	select EC_GOOGLE_CHROMEEC
	select EC_GOOGLE_CHROMEEC_ESPI
	select EC_GOOGLE_CHROMEEC_ACPI_MEMMAP
	select DRIVERS_INTEL_USB4_RETIMER
	select DRIVERS_INTEL_WIFI
	select DRIVERS_GFX_GENERIC
	select DRIVERS_INTEL_PMC
	select HAVE_ACPI_TABLES
	select HAVE_INTEL_PTT
	select INTEL_GMA_HAVE_VBT
	select INTEL_LPSS_UART_FOR_CONSOLE
	select MEMORY_MAPPED_TPM
	select PMC_IPC_ACPI_INTERFACE
	select MAINBOARD_HAS_TPM2
	select NO_UART_ON_SUPERIO
	select PCIEXP_SUPPORT_RESIZABLE_BARS
	select SOC_INTEL_COMMON_BLOCK_HDA_VERB
	select SKIP_SEND_CONNECT_TOPOLOGY_CMD
	select SOC_INTEL_ENABLE_USB4_PCIE_RESOURCES
	select SPD_READ_BY_WORD
	select SYSTEM_TYPE_LAPTOP
	select TPM_MEASURED_BOOT

config BOARD_FRAMEWORK_MARIGOLD
	select BOARD_FRAMEWORK_MARIGOLD_COMMON
	select FSP_TYPE_IOT
	select SOC_INTEL_METEORLAKE_U_H

if BOARD_FRAMEWORK_MARIGOLD_COMMON

config FMDFILE
	default "src/mainboard/\$(CONFIG_MAINBOARD_DIR)/board.fmd"

config MAINBOARD_DIR
	default "framework/marigold"

config MAINBOARD_PART_NUMBER
	default "Framework Laptop 13 (Intel Core Ultra Series 1)"

config MAINBOARD_SMBIOS_PRODUCT_NAME
	default "Laptop 13 (Intel Core Ultra Series 1)"

config MAINBOARD_FAMILY
	default "Laptop"

config CONSOLE_POST
	default y

config D3COLD_SUPPORT
	default y

config DIMM_SPD_SIZE
	default 1024

config ONBOARD_VGA_IS_PRIMARY
	default y

config PCIEXP_DEFAULT_MAX_RESIZABLE_BAR_BITS
	default 36

config POST_DEVICE
	default n

config UART_FOR_CONSOLE
	default 0

# PM Timer Disabled, saves power
config USE_PM_ACPI_TIMER
	default n

# The two USB-C PD controllers are programmed from firmware stored at fixed
# offsets near the start of the BIOS region (the PD1/PD2 FMAP regions in
# board.fmd). Point these at the PD firmware blobs to embed them at build time.
# An option left empty builds its region empty (0xff), so flashing preserves
# whatever PD firmware is already present on the chip.
config FRAMEWORK_PD1_FW_FILE
	string "PD1 firmware blob"
	default ""
	help
	  Path to the PD1 controller firmware. Must fit the PD1 FMAP region
	  (64K). Leave empty to not touch the PD1 region.

config FRAMEWORK_PD2_FW_FILE
	string "PD2 firmware blob"
	default ""
	help
	  Path to the PD2 controller firmware. Must fit the PD2 FMAP region
	  (64K). Leave empty to not touch the PD2 region.

# The Embedded Controller firmware lives in its own Intel flash descriptor
# region (SI_EC, see board.fmd), outside the BIOS region coreboot normally
# flashes. Setting this embeds the blob into SI_EC of the built image; left
# empty the region stays empty (0xff). Note: flashing it requires writing the
# EC region explicitly (e.g. flashrom with a layout), since coreboot's image
# carries no Intel Firmware Descriptor.
config FRAMEWORK_EC_FW_FILE
	string "EC firmware blob"
	default ""
	help
	  Path to the Embedded Controller firmware. Must fit the SI_EC FMAP
	  region (512K). Leave empty to not touch the EC region.

endif
```

## src/mainboard/framework/sakura/Kconfig
```kconfig
## SPDX-License-Identifier: GPL-2.0-or-later

config BOARD_FRAMEWORK_SAKURA_COMMON
	def_bool n
	select BOARD_ROMSIZE_KB_32768
	select CRB_TPM
	select DRIVERS_I2C_HID
	select EC_GOOGLE_CHROMEEC
	select EC_GOOGLE_CHROMEEC_ESPI
	select EC_GOOGLE_CHROMEEC_ACPI_MEMMAP
	select DRIVERS_INTEL_USB4_RETIMER
	select DRIVERS_INTEL_WIFI
	select DRIVERS_GFX_GENERIC
	select DRIVERS_INTEL_PMC
	select HAVE_ACPI_TABLES
	select HAVE_INTEL_PTT
	select INTEL_GMA_HAVE_VBT
	select INTEL_LPSS_UART_FOR_CONSOLE
	select MEMORY_MAPPED_TPM
	select PMC_IPC_ACPI_INTERFACE
	select MAINBOARD_HAS_TPM2
	select NO_UART_ON_SUPERIO
	select PCIEXP_SUPPORT_RESIZABLE_BARS
	select SOC_INTEL_COMMON_BLOCK_HDA_VERB
	select SOC_INTEL_ENABLE_USB4_PCIE_RESOURCES
	select SOC_INTEL_TCSS_USE_PDC_PMC_USBC_MUX_CONFIGURATION
	select SPD_READ_BY_WORD
	select SYSTEM_TYPE_LAPTOP
	select TPM_MEASURED_BOOT
	select VBOOT
	# No ChromeOS board glue (recovery/WP switch GPIOs, fill_lb_gpios); use
	# weak stubs. A/B slot failover relies on verification + try-counter, not
	# the EC recovery switch.
	select VBOOT_NO_BOARD_SUPPORT
	# VBOOT sets dead_code() in display_init_required() unless one of the
	# display options is chosen; this laptop always brings up the panel.
	select VBOOT_ALWAYS_ENABLE_DISPLAY
	select VBOOT_SLOTS_RW_AB
	# Verstage/CMOS-VBNV/HW-crypto come from the PTL SoC's `config VBOOT`.

config BOARD_FRAMEWORK_SAKURA
	select BOARD_FRAMEWORK_SAKURA_COMMON
	select FSP_TYPE_IOT
	select SOC_INTEL_PANTHERLAKE_U_H

if BOARD_FRAMEWORK_SAKURA_COMMON

config MAINBOARD_DIR
	default "framework/sakura"

config FMDFILE
	default "src/mainboard/\$(CONFIG_MAINBOARD_DIR)/board.fmd"

# Static test HWID. Without this the GBB recipe runs gen_test_hwid.sh on
# MAINBOARD_PART_NUMBER, whose literal "(...)" breaks the shell. HWID is only
# cosmetic on a non-ChromeOS board, so a fixed placeholder is fine.
config GBB_HWID
	string
	default "FRAMEWORK SAKURA TEST 0000"

# Enabling VBOOT reserves a 20K vboot work buffer in CAR (RSA accel), which
# pushes romstage ~2.5K over the 0xc0000 CAR window. The BSP stack (0x88000 =
# 512K FSP-M + 32K romstage) and the DDR5 SPD buffer (DIMM_MAX*1024) can't be
# trimmed safely, so reclaim CAR from the pre-RAM console buffer (debug-only;
# the log still moves to the CBMEM console once DRAM is up).
config PRERAM_CBMEM_CONSOLE_SIZE
	default 0x1000

# The PTL SoC default (0xd0000) is sized only for FSP-S preloading. Our UEFI
# payload is ~1.44 MB, so cbfs_preload() of the payload fails to allocate and
# trips an assert in commonlib/list.c. Enlarge the cache to fit dsdt.aml + the
# payload.
config RAMSTAGE_CBFS_CACHE_SIZE
	default 0x200000

config MAINBOARD_PART_NUMBER
	default "Framework Laptop 13 Pro (Intel Core Ultra Series 3)"

config MAINBOARD_SMBIOS_PRODUCT_NAME
	default "Laptop 13 Pro (Intel Core Ultra Series 3)"

config MAINBOARD_FAMILY
	default "Laptop"

config CONSOLE_POST
	default y

config D3COLD_SUPPORT
	default y

config DIMM_SPD_SIZE
	default 1024

config ONBOARD_VGA_IS_PRIMARY
	default y

config PCIEXP_DEFAULT_MAX_RESIZABLE_BAR_BITS
	default 36

config POST_DEVICE
	default n

config UART_FOR_CONSOLE
	default 0

# PM Timer Disabled, saves power
config USE_PM_ACPI_TIMER
	default n

endif
```

## src/mainboard/framework/tgl/Kconfig.name
```kconfig
## SPDX-License-Identifier: GPL-2.0-or-later

config BOARD_FRAMEWORK_TGL
	bool "Laptop 13 (11th Gen Intel Core)"
```

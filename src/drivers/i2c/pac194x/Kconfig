## src/drivers/i2c/pac194x/Kconfig
```kconfig
## SPDX-License-Identifier: GPL-2.0-only

config DRIVERS_I2C_PAC194X
	bool
	default n
	help
	  Microchip PAC194x/PAC195x multi-channel power monitor. Probes the
	  chip at init and describes it to the OS with the Microchip ACPI
	  _HID and configuration _DSM, so the Windows EMI driver and the
	  Linux pac1944 IIO driver bind without further setup.
```

## src/mainboard/framework/Kconfig
```kconfig
## SPDX-License-Identifier: GPL-2.0-or-later

if VENDOR_FRAMEWORK

choice
	prompt "Mainboard model"

source "src/mainboard/framework/*/Kconfig.name"

endchoice

source "src/mainboard/framework/*/Kconfig"

config MAINBOARD_VENDOR
	default "Framework"

config EC_GOOGLE_CHROMEEC_ACPI_HID
	default "FRMWC004"

config FRAMEWORK_COMMON_CFR
	def_bool y
	select DRIVERS_OPTION_CFR_ENABLED if PAYLOAD_EDK2 && SMMSTORE

config FRAMEWORK_TOUCHSCREEN_STYLUS
	bool
	help
	  Selected by boards that have a touchscreen stylus protocol switch GPIO
	  (stylus_sw_r), i.e. the Framework Laptop 12. Exposes a CFR option to
	  choose between the MPP and USI stylus protocols.

config FRAMEWORK_INPUT_DECK
	bool
	default n
	help
	  Selected by boards that have detectable input deck, to enable the Input
	  Deck Mode CFR option.

config FRAMEWORK_EC_PD_CHIP_COUNT
	int
	depends on EC_GOOGLE_CHROMEEC
	help
	  Number of USB-C Power Delivery controllers on the board. Used to size
	  the per-controller PD firmware version readouts in the CFR setup menu.
	  Each board sets its own value.

# Keyboard matrix positions (row/col) of the keys remapped by the key remap CFR
# options (swap Ctrl/Fn, Copilot key). The defaults match the Framework Laptop
# 13 keyboard; boards with a different matrix override these.
if EC_GOOGLE_CHROMEEC

config FRAMEWORK_KBD_FN_ROW
	int
	default 2

config FRAMEWORK_KBD_FN_COL
	int
	default 2

config FRAMEWORK_KBD_LEFT_CTRL_ROW
	int
	default 1

config FRAMEWORK_KBD_LEFT_CTRL_COL
	int
	default 12

config FRAMEWORK_KBD_RIGHT_CTRL_ROW
	int
	default 0

config FRAMEWORK_KBD_RIGHT_CTRL_COL
	int
	default 12

endif # EC_GOOGLE_CHROMEEC

endif # VENDOR_FRAMEWORK
```

## src/mainboard/framework/adlrpl/Kconfig
```kconfig
## SPDX-License-Identifier: GPL-2.0-or-later

config BOARD_FRAMEWORK_ADLRPL_COMMON
	def_bool n
	select BOARD_ROMSIZE_KB_32768
	select DRIVERS_I2C_HID
	select DRIVERS_INTEL_USB4_RETIMER
	select DRIVERS_INTEL_WIFI
	select EC_GOOGLE_CHROMEEC
	select EC_GOOGLE_CHROMEEC_ESPI
	select EC_GOOGLE_CHROMEEC_MEC
	select HAVE_ACPI_RESUME
	select HAVE_ACPI_TABLES
#	select HAVE_CMOS_DEFAULT
#	select HAVE_OPTION_TABLE
	select INTEL_GMA_HAVE_VBT
	select INTEL_LPSS_UART_FOR_CONSOLE
	select MEMORY_MAPPED_TPM
	select MAINBOARD_HAS_TPM2
	select NO_UART_ON_SUPERIO
	select SOC_INTEL_COMMON_BLOCK_HDA_VERB
	select SOC_INTEL_ENABLE_USB4_PCIE_RESOURCES
	select SPD_READ_BY_WORD
	select SPI_TPM
	select SYSTEM_TYPE_LAPTOP

config BOARD_FRAMEWORK_HX30
	select BOARD_FRAMEWORK_ADLRPL_COMMON
	select SOC_INTEL_ALDERLAKE_PCH_P

if BOARD_FRAMEWORK_ADLRPL_COMMON

config MAINBOARD_DIR
	default "framework/adlrpl"

config CONSOLE_POST
	default y

config DIMM_MAX
	default 2

config POST_DEVICE
	default n

config UART_FOR_CONSOLE
	default 0

config DRIVER_TPM_SPI_CHIP
	default 2

config FMDFILE
	default "src/mainboard/\$(CONFIG_MAINBOARD_DIR)/board.fmd"

endif
```

## src/mainboard/framework/adlrpl/Kconfig.name
```kconfig
## SPDX-License-Identifier: GPL-2.0-or-later

config BOARD_FRAMEWORK_HX30
	bool "Laptop 13 (12th Gen Intel Core)"

config BOARD_FRAMEWORK_IRIS
	bool "Laptop 13 (13th Gen Intel Core)"
```

## src/mainboard/framework/tgl/Kconfig
```kconfig
## SPDX-License-Identifier: GPL-2.0-or-later

config BOARD_FRAMEWORK_TGL_COMMON
	def_bool n
	select BOARD_ROMSIZE_KB_32768
	select DRIVERS_I2C_HID
	select DRIVERS_INTEL_USB4_RETIMER
	select DRIVERS_GFX_GENERIC
	select EC_GOOGLE_CHROMEEC
	select EC_GOOGLE_CHROMEEC_ESPI
	select EC_GOOGLE_CHROMEEC_MEC
	select EC_GOOGLE_CHROMEEC_ACPI_MEMMAP
	select HAVE_ACPI_RESUME
	select HAVE_ACPI_TABLES
	select INTEL_GMA_HAVE_VBT
	select INTEL_LPSS_UART_FOR_CONSOLE
	select MAINBOARD_HAS_TPM2
	select MEMORY_MAPPED_TPM
	select NO_UART_ON_SUPERIO
	select SOC_INTEL_COMMON_BLOCK_HDA_VERB
	select SOC_INTEL_ENABLE_USB4_PCIE_RESOURCES
	select SPD_CACHE_ENABLE
	select SPD_CACHE_IN_FMAP
	select SPD_READ_BY_WORD
	select SYSTEM_TYPE_LAPTOP
	select TPM_MEASURED_BOOT

config BOARD_FRAMEWORK_TGL
	select BOARD_FRAMEWORK_TGL_COMMON
	select SOC_INTEL_TIGERLAKE

if BOARD_FRAMEWORK_TGL_COMMON

config FMDFILE
	default "src/mainboard/\$(CONFIG_MAINBOARD_DIR)/board.fmd"

config MAINBOARD_DIR
	default "framework/tgl"

config MAINBOARD_PART_NUMBER
	default "TGL"

config MAINBOARD_SMBIOS_PRODUCT_NAME
	default "Laptop 13 (11th Gen Intel Core)"

config MAINBOARD_FAMILY
	default "Laptop"

config CONSOLE_POST
	default y

config D3COLD_SUPPORT
	default y

# DDR4 SO-DIMMs carry a 512 byte SPD EEPROM
config DIMM_SPD_SIZE
	default 512

config ONBOARD_VGA_IS_PRIMARY
	default y

config POST_DEVICE
	default n

# LPSS UART2 (GPP_C20/GPP_C21) is routed to the debug header
config UART_FOR_CONSOLE
	default 2

config TPM_PIRQ
	hex
	default 0x2c	# GPP_B20 TPM_PIRQ#

# PM Timer Disabled, saves power
config USE_PM_ACPI_TIMER
	default n

config VBOOT
	default y
	select VBOOT_ALWAYS_ENABLE_DISPLAY
	select VBOOT_CLEAR_RECOVERY_IN_RAMSTAGE
	select VBOOT_NO_BOARD_SUPPORT
	select VBOOT_SLOTS_RW_AB

endif
```
